## main/Kconfig.projbuild
```kconfig
menu "TriMet Station Display"

    config TRIMET_APP_ID
        string "TriMet appID"
        default ""
        help
            Developer appID from https://developer.trimet.org/appid/registration/.
            This is a secret: it is stored in sdkconfig, which is git-ignored.
            Do not put it in sdkconfig.defaults. Can be left empty and entered
            on the device instead (Settings > TriMet), which overrides it.

    config TRIMET_STREETCAR_STOP_IDS
        string "Streetcar stop IDs (comma-separated)"
        default "10772,10754"
        help
            Stops shown on the Streetcar page(s), 2 stops per page; more stops
            add more Streetcar pages. Only streetcar arrivals are shown.
            Streetcar + MAX stops together: at most 8.
            Defaults:
              10772  NW 10th & Glisan (northbound)
              10754  NW 11th & Glisan (southbound)

    config TRIMET_MAX_STOP_IDS
        string "MAX stop IDs (comma-separated)"
        default "7601,7763,8339,8378"
        help
            Stops shown on the MAX page(s). Only light rail arrivals are shown,
            so the 291/293 shuttle buses at these stops are hidden.
            2 stops per page; the defaults make two MAX pages
            (Union Station, then Old Town/Chinatown).
            Streetcar + MAX stops together: at most 8.
            Defaults:
              7601  Union Station/NW 5th & Glisan MAX (southbound)
              7763  Union Station/NW 6th & Hoyt MAX (northbound)
              8339  Old Town/Chinatown MAX (northbound; Red, Blue)
              8378  Old Town/Chinatown MAX (southbound; Red, Blue)

    config TRIMET_POLL_INTERVAL_SEC
        int "Arrivals poll interval (seconds)"
        range 30 120
        default 30
        help
            How often to request arrivals from TriMet, in 30 second steps.
            Default for Settings > TriMet on the device, which overrides it.

    config TRIMET_PAGE_ROTATE_SEC
        int "Page rotation interval (seconds)"
        range 5 30
        default 15
        help
            How long each page is shown before moving to the next.
            Tapping the middle of the screen also switches pages and restarts
            this timer. 5 second steps. Default for Settings > TriMet on the
            device, which overrides it.

    config TRIMET_TZ
        string "Time zone (POSIX TZ string)"
        default "PST8PDT,M3.2.0,M11.1.0"
        help
            Local time zone for the clock and night dimming. The default is
            US Pacific with daylight saving time. Overrides the template's
            IP-based time zone lookup, which uses a fixed UTC offset that
            does not follow DST changes. Leave empty to use the template's
            lookup.

    config TRIMET_STALE_RESTART_MIN
        int "Restart after this many minutes without arrivals (0 = never)"
        range 0 1440
        default 30
        help
            Restart the device if no arrivals have been fetched successfully
            for this long, to recover from Wi-Fi or network problems that do
            not clear on their own. During a long internet outage the device
            restarts once per interval. Crashes and hangs are handled
            separately by the ESP-IDF panic handler and task watchdog.

endmenu
```
